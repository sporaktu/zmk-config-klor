/*
 * Copyright (c) 2022 GEIST
 *
 * SPDX-License-Identifier: MIT
 */

#include "klor.dtsi"

&default_transform {
	col-offset = <6>;
};

&kscan0 {
	col-gpios
		= <&pro_micro 10 GPIO_ACTIVE_HIGH>
		, <&pro_micro 16 GPIO_ACTIVE_HIGH>
		, <&pro_micro 14 GPIO_ACTIVE_HIGH>
		, <&pro_micro 15 GPIO_ACTIVE_HIGH>
		, <&pro_micro 18 GPIO_ACTIVE_HIGH>
		, <&pro_micro 19 GPIO_ACTIVE_HIGH>
		;
};

// Disable encoders on right side - no encoder hardware present
// Override sensors array to be empty (no encoders on this side)
&sensors {
	sensors = <>;
};